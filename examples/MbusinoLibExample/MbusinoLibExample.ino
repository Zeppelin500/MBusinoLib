#include <MBusinoLib.h>   // Library for decode M-Bus
#include <ArduinoJson.h>  // ArduinoJson Version 7 is used to transfere the Data

#define START_ADDRESS 0x13  // Start address for decoding
unsigned long timerMbus = 5000;

void setup() {
  Serial.begin(9600);
}

void loop() {
  if (millis() - timerMbus > 5000) {
    timerMbus = millis();
    byte mbus_data[] = {0x68,0xC1,0xC1,0x68,0x08,0x00,0x72,0x09,0x34,0x75,0x73,0xC5,0x14,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0x75,0x16};
    //byte mbus_data[] = {0x68,0xC4,0xC4,0x68,0x08,0x14,0x72,0x72,0x91,0x07,0x29,0x47,0x5F,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0xFB,0x16};

    int packet_size = sizeof(mbus_data);

    // --- Unified JsonDocument ---
    JsonDocument doc;
    MBusinoLib decode;

    // 1. Decode Header into nested object "header"
    JsonObject headerObj = doc["header"].to<JsonObject>();
    bool headerOk = decode.decodeHeader(mbus_data, packet_size, headerObj);

    // 2. Decode Records into nested array "records"
    JsonArray recordsArr = doc["records"].to<JsonArray>();
    uint8_t fields = decode.decodeRecords(&mbus_data[START_ADDRESS], packet_size - START_ADDRESS - 2, recordsArr);

    // --- Serial Output START ---
    Serial.println();
    Serial.println();
    Serial.println("###################### new message ###################### ");
    Serial.println();
    Serial.print("error = ");
    Serial.println(decode.getError());
    Serial.print("jsonstring = ");
    serializeJson(doc, Serial);
    Serial.println();
    Serial.println();

    // --- M-Bus Header Data Output ---
    if (headerOk) {
      Serial.println("--- M-Bus Header Data (Individual Fields) ---");
      Serial.println();
      Serial.print("Adress(dec):    ");
      Serial.println(headerObj["address"].as<int>());
      Serial.print("ID:             ");
      Serial.println(headerObj["id"].as<const char*>());
      Serial.print("Manufacturer:   ");
      Serial.println(headerObj["manufacturer"].as<const char*>());
      Serial.print("Medium:         ");
      Serial.println(headerObj["medium"].as<const char*>());
      Serial.print("Status Byte:    ");
      Serial.print("0x");
      Serial.println(headerObj["status"].as<int>(), HEX);
      Serial.print("Version:        ");
      Serial.println(headerObj["version"].as<int>());
      Serial.print("Access Counter: ");
      Serial.println(headerObj["access_counter"].as<int>());

      // Status details
      Serial.print("Battery Low:    ");
      Serial.println(headerObj["status_details"]["battery_low"].as<bool>() ? "YES" : "NO");
      Serial.print("Temporary Err:  ");
      Serial.println(headerObj["status_details"]["temporary_error"].as<bool>() ? "YES" : "NO");
      Serial.print("Permanent Err:  ");
      Serial.println(headerObj["status_details"]["permanent_error"].as<bool>() ? "YES" : "NO");
    }
    Serial.println();
    Serial.println("--- M-Bus Records ---");
    Serial.println();

    // --- M-Bus Record Output ---
    for (uint8_t i = 0; i < fields; i++) {
      const char* name = recordsArr[i]["name"];
      const char* units = recordsArr[i]["units"];
      double value = recordsArr[i]["value_scaled"].as<double>();
      const char* valueString = recordsArr[i]["value_string"];

      // Variable string value
      if (valueString != NULL) {
        Serial.print(i + 1); Serial.print("_vs_"); Serial.print(name); Serial.print(" = "); Serial.println(valueString);
      }

      // Numeric value
      Serial.print(i + 1); Serial.print("_"); Serial.print(name); Serial.print(" = ");

      // Fix for "ovf" on large numbers like time points
      if (value > 1000000000.0) {
        Serial.println((int64_t)value);
      } else {
        Serial.println(value, 3);
      }

      // Unit
      if (units != NULL) {
        Serial.print(i + 1); Serial.print("_"); Serial.print(name); Serial.print("_unit = "); Serial.println(units);
      }
    }
    Serial.println("###################### end of message ###################### ");
  }
}

